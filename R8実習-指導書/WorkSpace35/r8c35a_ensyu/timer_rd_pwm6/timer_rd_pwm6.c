/****************************************************************************/
/* 対象マイコン R8C/35A                                                     */
/* ﾌｧｲﾙ内容     タイマRDのPWMモードを使ってPWM6本出力                       */
/* バージョン   Ver.1.20                                                    */
/* Date         2010.04.19                                                  */
/* Copyright    ルネサスマイコンカーラリー事務局                            */
/*              日立インターメディックス株式会社                            */
/****************************************************************************/
/*
入力：マイコンボードのディップスイッチ(4bit)
出力：P2_1,P2_2,P2_3,P2_5,P2_6,P2_7端子からPWM出力

マイコンボードのディップスイッチ(4bit)から入力した割合により、
ポート2の6端子からPWM波形を出力します。
*/

/*======================================*/
/* インクルード                         */
/*======================================*/
#include "sfr_r835a.h"                  /* R8C/35A SFRの定義ファイル    */

/*======================================*/
/* シンボル定義                         */
/*======================================*/

/*======================================*/
/* プロトタイプ宣言                     */
/*======================================*/
void init( void );
unsigned char dipsw_get( void );

/************************************************************************/
/* メインプログラム                                                     */
/************************************************************************/
void main( void )
{
    unsigned int    pwm;

    init();                             /* 初期化                       */

    while( 1 ) {
        if( dipsw_get() == 0 ) {
            // trdgra0,trdgra1と同じにすると0%出力
            pwm = 39999;
        } else if( dipsw_get() == 15 ) {
            // trdgra0,trdgra1より大きくすると100%出力
            pwm = 40000;
        } else {
            // 1～14なら割合に応じてPWM出力する
            pwm = (long)39999 * dipsw_get() / 15;
        }

        trdgrb0  = pwm;                 /* P2_2のON幅設定               */
        trdgrc0  = pwm;                 /* P2_1のON幅設定               */
        trdgrd0  = pwm;                 /* P2_3のON幅設定               */
        trdgrb1  = pwm;                 /* P2_5のON幅設定               */
        trdgrc1  = pwm;                 /* P2_6のON幅設定               */
        trdgrd1  = pwm;                 /* P2_7のON幅設定               */
    }
}

/************************************************************************/
/* R8C/35A スペシャルファンクションレジスタ(SFR)の初期化                */
/************************************************************************/
void init( void )
{
    int i;

    /* クロックをXINクロック(20MHz)に変更 */
    prc0  = 1;                          /* プロテクト解除               */
    cm13  = 1;                          /* P4_6,P4_7をXIN-XOUT端子にする*/
    cm05  = 0;                          /* XINクロック発振              */
    for(i=0; i<50; i++ );               /* 安定するまで少し待つ(約10ms) */
    ocd2  = 0;                          /* システムクロックをXINにする  */
    prc0  = 0;                          /* プロテクトON                 */

    /* ポートの入出力設定 */
    prc2 = 1;                           /* PD0のプロテクト解除          */
    pd0 = 0x00;                         /* スイッチなど入力             */
    p1  = 0x0f;                         /* 3-0:LEDは消灯                */
    pd1 = 0xdf;                         /* 5:RXD0 4:TXD0 3-0:LED        */
    pd2 = 0xfe;                         /* 0:PushSW                     */
    pd3 = 0xfb;                         /* 4:Buzzer 2:IR                */
    pd4 = 0x80;                         /* 7:XOUT 6:XIN 5-3:DIP SW 2:VREF*/
    pd5 = 0x40;                         /* 7:DIP SW                     */
    pd6 = 0xff;                         /* LEDなど出力                  */

    /* タイマRD PWMモードの設定(6本のPWM出力) */
    trdpmr   = 0x77;                    /* 各端子PWMﾓｰﾄﾞにするかしないか*/
    trdfcr   = 0x80;                    /* PWMモードに設定              */
    trdoer1  = 0x11;                    /* 各端子出力許可するかしないか */
    trdpsr0  = 0x68;                    /* TRDIOB0,C0,D0端子設定        */
    trdpsr1  = 0x54;                    /* TRDIOB1,C1,D1端子設定        */
    trdocr   = 0x00;                    /* 各端子初期出力設定           */
    trdcr0   = 0x23;                    /* TRD0ソースカウントの選択:f8  */
    trdcr1   = 0x23;                    /* TRD1ソースカウントの選択:f8  */
    trdpocr0 = 0x00;                    /* B0～D0のアクティブレベル設定 */
    trdpocr1 = 0x00;                    /* B1～D1のアクティブレベル設定 */
    trdgra0  = 39999;                   /* TRD0の周期設定               */
    trdgra1  = 39999;                   /* TRD1の周期設定               */
    trdgrb0  = 0;                       /* P2_2のON幅設定               */
    trdgrc0  = 0;                       /* P2_1のON幅設定               */
    trdgrd0  = 0;                       /* P2_3のON幅設定               */
    trdgrb1  = 0;                       /* P2_5のON幅設定               */
    trdgrc1  = 0;                       /* P2_6のON幅設定               */
    trdgrd1  = 0;                       /* P2_7のON幅設定               */
    trdstr   = 0x0f;                    /* TRD0,TRD1カウント開始        */
}

/************************************************************************/
/* ディップスイッチ値読み込み                                           */
/* 戻り値 スイッチ値 0～15                                              */
/************************************************************************/
unsigned char dipsw_get( void )
{
    unsigned char sw, sw1, sw2;

    sw1 = (p5>>4) & 0x08;               /* ディップスイッチ読み込み3    */
    sw2 = (p4>>3) & 0x07;               /* ディップスイッチ読み込み2,1,0*/
    sw = sw1 | sw2;                     /* P5とP4の値を合わせる         */

    return  sw;
}

/************************************************************************/
/* end of file                                                          */
/************************************************************************/
