/****************************************************************************/
/* 対象マイコン R8C/35A                                                     */
/* ﾌｧｲﾙ内容     INT割り込み                                                 */
/* バージョン   Ver.1.20                                                    */
/* Date         2010.04.19                                                  */
/* Copyright    ルネサスマイコンカーラリー事務局                            */
/*              日立インターメディックス株式会社                            */
/****************************************************************************/
/*
入力：INT3(P3_3)(実習基板のトグルスイッチ部などチャタリングのない信号)
出力：マイコンボードのLED(4bit)

INT3(P3_3)端子から入力された信号により割り込みプログラムを実行します。
割り込みは、立ち下がり(1"→"0"の瞬間)でかかるように設定します。
INT3割り込みの発生ごとに、マイコンボードのLEDが＋１していきます。
メイン関数では、プロジェクト「timer1」のmain関数の内容を実行しています。
*/

/*======================================*/
/* インクルード                         */
/*======================================*/
#include "sfr_r835a.h"                  /* R8C/35A SFRの定義ファイル    */

/*======================================*/
/* シンボル定義                         */
/*======================================*/

/*======================================*/
/* プロトタイプ宣言                     */
/*======================================*/
void init( void );
void led_out( unsigned char led );
void timer( unsigned long timer_set );

/*======================================*/
/* グローバル変数の宣言                 */
/*======================================*/
unsigned char cnt_int3;                 /* INT3割り込みごとに+1         */

/************************************************************************/
/* メインプログラム                                                     */
/************************************************************************/
void main( void )
{
    unsigned char d;

    init();                             /* 初期化                       */
    asm(" fset I ");                    /* 全体の割り込み許可           */

    while( 1 ) {
        p6 = 0x55;
        timer( 1000 );
        p6 = 0xaa;
        timer( 1000 );
        p6 = 0x00;
        timer( 1000 );
    }
}

/************************************************************************/
/* R8C/35A スペシャルファンクションレジスタ(SFR)の初期化                */
/************************************************************************/
void init( void )
{
    int i;

    /* クロックをXINクロック(20MHz)に変更 */
    prc0  = 1;                          /* プロテクト解除               */
    cm13  = 1;                          /* P4_6,P4_7をXIN-XOUT端子にする*/
    cm05  = 0;                          /* XINクロック発振              */
    for(i=0; i<50; i++ );               /* 安定するまで少し待つ(約10ms) */
    ocd2  = 0;                          /* システムクロックをXINにする  */
    prc0  = 0;                          /* プロテクトON                 */

    /* ポートの入出力設定 */
    prc2 = 1;                           /* PD0のプロテクト解除          */
    pd0 = 0xe0;                         /* 7-5:LED 4:MicroSW 3-0:Sensor */
    p1  = 0x0f;                         /* 3-0:LEDは消灯                */
    pd1 = 0xdf;                         /* 5:RXD0 4:TXD0 3-0:LED        */
    pd2 = 0xfe;                         /* 0:PushSW                     */
    pd3 = 0xf3;                         /* 4:Buzzer 3:INT3 2:IR         */
    pd4 = 0x80;                         /* 7:XOUT 6:XIN 5-3:DIP SW 2:VREF*/
    pd5 = 0x40;                         /* 7:DIP SW                     */
    pd6 = 0xff;                         /* LEDなど出力                  */

    /* INT0～4割り込み設定(今回はINT3を設定) */
    intsr  = 0x00;                      /* INT1～3の入力端子設定        */
    inten  = 0x40;                      /* INT0～3の外部入力許可設定    */
    inten1 = 0x00;                      /* INT4の外部入力許可設定       */
    intf   = 0xc0;                      /* INT0～3の入力フィルタ選択    */
    intf1  = 0x00;                      /* INT4の入力フィルタ選択       */

    int0ic = 0x00;                      /* INT0割り込み優先レベル設定   */
    int1ic = 0x00;                      /* INT1割り込み優先レベル設定   */
    int2ic = 0x00;                      /* INT2割り込み優先レベル設定   */
    int3ic = 0x07;                      /* INT3割り込み優先レベル設定   */
    int4ic = 0x00;                      /* INT4割り込み優先レベル設定   */
}

/************************************************************************/
/* マイコン部のLED出力                                                  */
/* 引数　 スイッチ値 0～15                                              */
/************************************************************************/
void led_out( unsigned char led )
{
    unsigned char data;

    led = ~led;
    led &= 0x0f;
    data = p1 & 0xf0;
    p1 = data | led;
}

/************************************************************************/
/* タイマ本体                                                           */
/* 引数　 タイマ値 1=1ms                                                */
/************************************************************************/
void timer( unsigned long timer_set )
{
    int i;

    do {
        for( i=0; i<1240; i++ );
    } while( timer_set-- );
}

/************************************************************************/
/* INT3 割り込み処理                                                    */
/************************************************************************/
#pragma interrupt intINT3(vect=26)
void intINT3( void )
{
    cnt_int3++;
    led_out( cnt_int3 );
}

/************************************************************************/
/* end of file                                                          */
/************************************************************************/
