/****************************************************************************/
/* 対象マイコン R8C/35A                                                     */
/* ﾌｧｲﾙ内容     データフラッシュの書き換え                                  */
/* バージョン   Ver.1.21                                                    */
/* Date         2012.03.12                                                  */
/* Copyright    ルネサスマイコンカーラリー事務局                            */
/*              日立インターメディックス株式会社                            */
/****************************************************************************/
/*
入力：マイコンボードのディップスイッチ
出力：マイコンボードのLED

データフラッシュに書き込んでいる値をマイコンボードのLEDに出力します。
マイコンボード上のプッシュスイッチを押すと、
ディップスイッチの値をデータフラッシュに保存します。
*/

/*======================================*/
/* インクルード                         */
/*======================================*/
#include    "sfr_r835a.h"               /* R8C/35A SFRの定義ファイル    */
#include    "data_flash_lib.h"          /* データフラッシュライブラリ   */

/*======================================*/
/* シンボル定義                         */
/*======================================*/
/* データフラッシュ関連 */
#define     DF_SIZE             64      /* 読み書きサイズ               */

#define     DF_CHECK            0       /* データフラッシュチェック     */
#define     DF_DATA             1       /* データ                       */

/*======================================*/
/* プロトタイプ宣言                     */
/*======================================*/
void init( void );
unsigned char dipsw_get( void );
void led_out( unsigned char led );
unsigned char pushsw_get( void );
void timer( unsigned long timer_set );

/*======================================*/
/* グローバル変数の宣言                 */
/*======================================*/
/* データフラッシュ関連 */
signed char data_buff[ DF_SIZE ];       /* 一時保存エリア               */

/************************************************************************/
/* メインプログラム                                                     */
/************************************************************************/
void main( void )
{
    int ret;

    init();                             /* 初期化                       */

    readDataFlash( 0x3000, data_buff, DF_SIZE );

    if( data_buff[DF_CHECK] != 0x35 ) {
        data_buff[DF_CHECK] = 0x35;
        data_buff[DF_DATA]  = 0;
    }

    led_out( data_buff[DF_DATA] );

    while( !pushsw_get() );

    data_buff[DF_DATA]  = dipsw_get();
    blockEraseDataFlash( 0x3000 );
    ret = writeDataFlash( 0x3000, data_buff, DF_SIZE );

    if( ret == 0 ) {
        /* 書き込みエラーなら */
        while( 1 ) {
        led_out( 0xc );
        timer( 100 );
        led_out( 0x3 );
        timer( 100 );
        }
    }

    /* 書き込みが正常にできたなら */
    while( 1 ) {
        led_out( 0x5 );
        timer( 200 );
        led_out( 0xa );
        timer( 200 );
    }
}

/************************************************************************/
/* R8C/35A スペシャルファンクションレジスタ(SFR)の初期化                */
/************************************************************************/
void init( void )
{
    int i;

    /* クロックをXINクロック(20MHz)に変更 */
    prc0  = 1;                          /* プロテクト解除               */
    cm13  = 1;                          /* P4_6,P4_7をXIN-XOUT端子にする*/
    cm05  = 0;                          /* XINクロック発振              */
    for(i=0; i<50; i++ );               /* 安定するまで少し待つ(約10ms) */
    ocd2  = 0;                          /* システムクロックをXINにする  */
    prc0  = 0;                          /* プロテクトON                 */

    /* ポートの入出力設定 */
    prc2 = 1;                           /* PD0のプロテクト解除          */
    pd0 = 0xe0;                         /* 7-5:LED 4:MicroSW 3-0:Sensor */
    p1  = 0x0f;                         /* 3-0:LEDは消灯                */
    pd1 = 0xdf;                         /* 5:RXD0 4:TXD0 3-0:LED        */
    pd2 = 0xfe;                         /* 0:PushSW                     */
    pd3 = 0xfb;                         /* 4:Buzzer 2:IR                */
    pd4 = 0x83;                         /* 7:XOUT 6:XIN 5-3:DIP SW 2:VREF*/
    pd5 = 0x40;                         /* 7:DIP SW                     */
    pd6 = 0xff;
}

/************************************************************************/
/* ディップスイッチ値読み込み                                           */
/* 戻り値 スイッチ値 0～15                                              */
/************************************************************************/
unsigned char dipsw_get( void )
{
    unsigned char sw, sw1, sw2;

    sw1 = (p5>>4) & 0x08;               /* ディップスイッチ読み込み3    */
    sw2 = (p4>>3) & 0x07;               /* ディップスイッチ読み込み2,1,0*/
    sw = sw1 | sw2;                     /* P5とP4の値を合わせる         */

    return  sw;
}

/************************************************************************/
/* プッシュスイッチ値読み込み                                           */
/* 戻り値 スイッチ値 ON:1 OFF:0                                         */
/************************************************************************/
unsigned char pushsw_get( void )
{
    unsigned char sw;

    sw  = ~p2;                          /* スイッチのあるポート読み込み */
    sw &= 0x01;

    return  sw;
}

/************************************************************************/
/* マイコン部のLED出力                                                  */
/* 引数　 スイッチ値 0～15                                              */
/************************************************************************/
void led_out( unsigned char led )
{
    unsigned char data;

    led = ~led;
    led &= 0x0f;
    data = p1 & 0xf0;
    p1 = data | led;
}

/************************************************************************/
/* タイマ本体                                                           */
/* 引数　 タイマ値 1=1ms                                                */
/************************************************************************/
void timer( unsigned long timer_set )
{
    int i;

    do {
        for( i=0; i<1240; i++ );
    } while( timer_set-- );
}

/************************************************************************/
/* end of file                                                          */
/************************************************************************/
