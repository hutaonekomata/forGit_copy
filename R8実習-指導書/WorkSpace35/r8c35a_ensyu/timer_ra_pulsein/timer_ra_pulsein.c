/****************************************************************************/
/* 対象マイコン R8C/35A                                                     */
/* ﾌｧｲﾙ内容     タイマRAによるパルス幅測定                                  */
/* バージョン   Ver.1.20                                                    */
/* Date         2010.04.19                                                  */
/* Copyright    ルネサスマイコンカーラリー事務局                            */
/*              日立インターメディックス株式会社                            */
/****************************************************************************/
/*
入力：TRAIO端子(P3_2)
出力：P6_7-P6_0(LEDなど)

P3_2に入力したパルスのON幅を測定、LEDへ出力します。
*/

/*======================================*/
/* インクルード                         */
/*======================================*/
#include "sfr_r835a.h"                  /* R8C/35A SFRの定義ファイル    */

/*======================================*/
/* シンボル定義                         */
/*======================================*/

/*======================================*/
/* プロトタイプ宣言                     */
/*======================================*/
void init( void );

/*======================================*/
/* グローバル変数の宣言                 */
/*======================================*/
unsigned int    pulse_width;            /* パルス幅 1当たり400[ns]      */

/************************************************************************/
/* メインプログラム                                                     */
/************************************************************************/
void main( void )
{
    init();                             /* 初期化                       */
    asm(" fset I ");                    /* 全体の割り込み許可           */

    while( 1 ) {
        p6 = pulse_width ;         /* パルスカウント下位8bit       */
    }
}

/************************************************************************/
/* R8C/35A スペシャルファンクションレジスタ(SFR)の初期化                */
/************************************************************************/
void init( void )
{
    int i;

    /* クロックをXINクロック(20MHz)に変更 */
    prc0  = 1;                          /* プロテクト解除               */
    cm13  = 1;                          /* P4_6,P4_7をXIN-XOUT端子にする*/
    cm05  = 0;                          /* XINクロック発振              */
    for(i=0; i<50; i++ );               /* 安定するまで少し待つ(約10ms) */
    ocd2  = 0;                          /* システムクロックをXINにする  */
    prc0  = 0;                          /* プロテクトON                 */

    /* ポートの入出力設定 */
    prc2 = 1;                           /* PD0のプロテクト解除          */
    pd0 = 0xe0;                         /* 7-5:LED 4:MicroSW 3-0:Sensor */
    pd1 = 0xdf;                         /* 5:RXD0 4:TXD0 3-0:LED        */
    p1  = 0x0f;                         /* 3-0:LEDは消灯                */
    pd2 = 0xfe;                         /* 0:PushSW                     */
    pd3 = 0xfb;                         /* 4:Buzzer 2:パルス入力        */
    pd4 = 0x83;                         /* 7:XOUT 6:XIN 5-3:DIP SW 2:VREF*/
    pd5 = 0x40;                         /* 7:DIP SW                     */
    pd6 = 0xff;                         /* LEDなど出力                  */

    /* タイマRA パルス幅測定モードの設定 */
    tramr  = 0x13;                      /* パルス幅測定モードに設定     */
    trasr  = 0x03;                      /* TRAIO端子:P3_2に設定         */
    traioc = 0x11;                      /* Highレベル幅の測定           */
    traic  = 0x01;                      /* タイマRAの割り込みレベル設定 */
    tstart_tracr = 1;                   /* TRAのカウント開始            */
}

/************************************************************************/
/* タイマRA 割り込み処理                                                */
/************************************************************************/
#pragma interrupt   _timer_ra(vect=22)
void _timer_ra( void )
{
    ir_traic = 0;

    if( tundf_tracr == 1) {             /* アンダフローあり？           */
        tundf_tracr = 0;
        // 400ns×65536=26.11ms ONなら計測できない
    }

    if( tedgf_tracr == 1 ) {            /* 立ち下がり検出               */
        tedgf_tracr = 0;

        /* パルス幅セット */
        pulse_width = ((255-tra) << 8) + (255-trapre);

        /* カウンタクリア(いったん停止させてセット) */
        tstart_tracr = 0;
        tra    = 0xff;
        trapre = 0xff;
        tstart_tracr = 1;
    }
}

/************************************************************************/
/* end of file                                                          */
/************************************************************************/
