/****************************************************************************/
/* 対象マイコン R8C/35A                                                     */
/* ﾌｧｲﾙ内容     センサ部のLEDへ値を出力                                     */
/* バージョン   Ver.1.20                                                    */
/* Date         2010.04.19                                                  */
/* Copyright    ルネサスマイコンカーラリー事務局                            */
/*              日立インターメディックス株式会社                            */
/****************************************************************************/
/*
入力：マイコンボードのディップスイッチ(4bit)
出力：センサ部のLED D1～D4(P0_7～P0_5)

マイコンボードのディップスイッチ(4bit)から入力した状態を、
センサ部のLED(P0_7～P0_5)に出力します。
P0_7～P0_5の3bitの組み合わせで、センサ部の4個のLED(D1～D4)を点灯させます。
実際の点灯作業は、割り込み内で行います。
*/

/*======================================*/
/* インクルード                         */
/*======================================*/
#include "sfr_r835a.h"                  /* R8C/35A SFRの定義ファイル    */

/*======================================*/
/* シンボル定義                         */
/*======================================*/

/*======================================*/
/* プロトタイプ宣言                     */
/*======================================*/
void init( void );
unsigned char dipsw_get( void );
void sensorled_out( unsigned char led );

/*======================================*/
/* グローバル変数の宣言                 */
/*======================================*/
unsigned char   sensorled_data;         /* sensorledへ出力する値        */

/************************************************************************/
/* メインプログラム                                                     */
/************************************************************************/
void main( void )
{
    unsigned char d;

    init();                             /* 初期化                       */
    asm(" fset I ");                    /* 全体の割り込み許可           */

    while( 1 ) {
        d = dipsw_get();
        sensorled_out( d );
    }
}

/************************************************************************/
/* R8C/35A スペシャルファンクションレジスタ(SFR)の初期化                */
/************************************************************************/
void init( void )
{
    int i;

    /* クロックをXINクロック(20MHz)に変更 */
    prc0  = 1;                          /* プロテクト解除               */
    cm13  = 1;                          /* P4_6,P4_7をXIN-XOUT端子にする*/
    cm05  = 0;                          /* XINクロック発振              */
    for(i=0; i<50; i++ );               /* 安定するまで少し待つ(約10ms) */
    ocd2  = 0;                          /* システムクロックをXINにする  */
    prc0  = 0;                          /* プロテクトON                 */

    /* ポートの入出力設定 */
    prc2 = 1;                           /* PD0のプロテクト解除          */
    pd0 = 0xe0;                         /* 7-5:LED 4:MicroSW 3-0:Sensor */
    p1  = 0x0f;                         /* 3-0:LEDは消灯                */
    pd1 = 0xdf;                         /* 5:RXD0 4:TXD0 3-0:LED        */
    pd2 = 0xfe;                         /* 0:PushSW                     */
    pd3 = 0xfb;                         /* 4:Buzzer 2:IR                */
    pd4 = 0x83;                         /* 7:XOUT 6:XIN 5-3:DIP SW 2:VREF*/
    pd5 = 0x40;                         /* 7:DIP SW                     */
    pd6 = 0xff;

    /* タイマRBの設定 */
    /* 割り込み周期 = 1 / 20[MHz]    * (TRBPRE+1) * (TRBPR+1)
                    = 1 / (20*10^-6) * 200        * 100
                    = 0.001[s] = 1[ms]
    */
    trbmr  = 0x00;                      /* 動作モード、分周比設定       */
    trbpre = 200-1;                     /* プリスケーラレジスタ         */
    trbpr  = 100-1;                     /* プライマリレジスタ           */
    trbic  = 0x07;                      /* 割り込み優先レベル設定       */
    trbcr  = 0x01;                      /* カウント開始                 */
}

/************************************************************************/
/* ディップスイッチ値読み込み                                           */
/* 戻り値 スイッチ値 0～15                                              */
/************************************************************************/
unsigned char dipsw_get( void )
{
    unsigned char sw, sw1, sw2;

    sw1 = (p5>>4) & 0x08;               /* ディップスイッチ読み込み3    */
    sw2 = (p4>>3) & 0x07;               /* ディップスイッチ読み込み2,1,0*/
    sw = sw1 | sw2;                     /* P5とP4の値を合わせる         */

    return  sw;
}

/************************************************************************/
/* センサ部のLED出力                                                    */
/* 引数　 LEDへの出力値 0～15                                           */
/************************************************************************/
void sensorled_out( unsigned char led )
{
    /* この関数では、LED出力値を保存するだけ */
    sensorled_data = led;
}

/************************************************************************/
/* タイマRB 割り込み処理                                                */
/************************************************************************/
#pragma interrupt intTRB(vect=24)
void intTRB( void )
{
    /* 実際にセンサ部のLEDへ出力する */
    if( p0 & 0x80 ) {
        /* P0_7が"1"なら */
        p0 &= 0x1f;                     /* P0_7～P0_5を"0"にして全消灯  */
        if( sensorled_data & 0x8 ) p0 |= 0x40;      /* D1点灯           */
        if( sensorled_data & 0x2 ) p0 |= 0x20;      /* D3点灯           */
    } else {
        /* P0_7が"0"なら */
        p0 |= 0xe0;                     /* P0_7～P0_5を"1"にして全消灯  */
        if( sensorled_data & 0x4 ) p0 &= 0xbf;      /* D2点灯           */
        if( sensorled_data & 0x1 ) p0 &= 0xdf;      /* D4点灯           */
    }
}

/************************************************************************/
/* end of file                                                          */
/************************************************************************/
