/****************************************************************************/
/* 対象マイコン R8C/35A                                                     */
/* ﾌｧｲﾙ内容     printf文、scanf文の使用例                                   */
/* バージョン   Ver.1.20                                                    */
/* Date         2010.04.19                                                  */
/* Copyright    ルネサスマイコンカーラリー事務局                            */
/*              日立インターメディックス株式会社                            */
/****************************************************************************/
/*
入力：UART0(パソコンのキーボードで入力したデータ)
　　　※パソコンはTeraTermProなどの通信ソフトを使用します
出力：P6_7-P6_0(LEDなど)

TeraTermProなどの通信ソフトを通して、キーボードから入力した数値を
ポート6に接続したLEDなどへ出力します。
C言語でおなじみのprintf文、scanf文を使用した演習です。
*/

/*======================================*/
/* インクルード                         */
/*======================================*/
#include    <stdio.h>
#include    "sfr_r835c.h"               /* R8C/35A SFRの定義ファイル    */
#include    "printf_lib.h"              /* printf使用ライブラリ         */

/*======================================*/
/* シンボル定義                         */
/*======================================*/

/*======================================*/
/* プロトタイプ宣言                     */
/*======================================*/
void init( void );

/************************************************************************/
/* メインプログラム                                                     */
/************************************************************************/
void main( void )
{
    int     i, ret;
    char    c;

    init();                             /* SFRの初期化                  */
    init_uart0_printf( SPEED_9600 );    /* UART0とprintf関連の初期化    */
    asm(" fset I ");                    /* 全体の割り込み許可           */

    printf( "Hello World!\n" );

    while( 1 ) {
        printf( "Input data : " );
        ret = scanf( "%d", &i );
        if( ret == 1 ) {
            printf( "Get data : %d\n", i );
            p6 = i;
        } else {
            printf( "Data Error!!\n" );
            scanf( "%*[^\n]" );
        }
    }
}

/************************************************************************/
/* R8C/35A スペシャルファンクションレジスタ(SFR)の初期化                */
/************************************************************************/
void init( void )
{
    int i;

    /* クロックをXINクロック(20MHz)に変更 */
    prc0  = 1;                          /* プロテクト解除               */
    cm13  = 1;                          /* P4_6,P4_7をXIN-XOUT端子にする*/
    cm05  = 0;                          /* XINクロック発振              */
    for(i=0; i<50; i++ );               /* 安定するまで少し待つ(約10ms) */
    ocd2  = 0;                          /* システムクロックをXINにする  */
    prc0  = 0;                          /* プロテクトON                 */

    /* ポートの入出力設定 */
    prc2 = 1;                           /* PD0のプロテクト解除          */
    pd0 = 0xe0;                         /* 7-5:LED 4:MicroSW 3-0:Sensor */
    p1  = 0x0f;                         /* 3-0:LEDは消灯                */
    pd1 = 0xdf;                         /* 5:RXD0 4:TXD0 3-0:LED        */
    pd2 = 0xfe;                         /* 0:PushSW                     */
    pd3 = 0xfb;                         /* 4:Buzzer 2:IR                */
    pd4 = 0x83;                         /* 7:XOUT 6:XIN 5-3:DIP SW 2:VREF*/
    pd5 = 0x40;                         /* 7:DIP SW                     */
    pd6 = 0xff;                         /* LEDなど出力                  */
}

/************************************************************************/
/* end of file                                                          */
/************************************************************************/
