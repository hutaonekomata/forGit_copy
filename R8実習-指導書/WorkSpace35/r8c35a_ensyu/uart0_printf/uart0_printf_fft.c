/****************************************************************************/
/* 対象ﾏｲｺﾝ R8C/35A                                                     */
/* ﾌｧｲﾙ内容     printf文、scanf文の使用例                                   */
/* ﾊﾞｰｼﾞｮﾝ   Ver.1.20                                                    */
/* Date         2010.04.19                                                  */
/* Copyright    ﾙﾈｻｽﾏｲｺﾝｶｰﾗﾘｰ事務局                            */
/*              日立ｲﾝﾀｰﾒﾃﾞｨｯｸｽ株式会社                            */
/****************************************************************************/
/*
入力:UART0(ﾊﾟｿｺﾝのｷｰﾎﾞｰﾄﾞで入力したﾃﾞｰﾀ)
   ※ﾊﾟｿｺﾝはTeraTermProなどの通信ｿﾌﾄを使用します
出力:P6_7-P6_0(LEDなど)

TeraTermProなどの通信ｿﾌﾄを通して、ｷｰﾎﾞｰﾄﾞから入力した数値を
ﾎﾟｰﾄ6に接続したLEDなどへ出力します。
C言語でおなじみのprintf文、scanf文を使用した演習です。
*/

/*======================================*/
/* ｲﾝｸﾙｰﾄﾞ                         */
/*======================================*/
#include    <stdio.h>
#include    "sfr_r835c.h"               /* R8C/35A SFRの定義ﾌｧｲﾙ    */
#include    "printf_lib.h"              /* printf使用ﾗｲﾌﾞﾗﾘ         */

/*======================================*/
/* ｼﾝﾎﾞﾙ定義                         */
/*======================================*/

/*======================================*/
/* ﾌﾟﾛﾄﾀｲﾌﾟ宣言                     */
/*======================================*/
void init( void );

/************************************************************************/
/* ﾒｲﾝﾌﾟﾛｸﾞﾗﾑ                                                     */
/************************************************************************/
void main( void )
{
    int     i,j, ret;
    char    c;
    int L,n;
    double X[4100],Y[4100],f;
     int ns,L1,arg,arg2,i0,i1,m[4100],n1;
     double s,c,sc,X1,Y1,t,PI;

    init();                             /* SFRの初期化                  */
    init_uart0_printf( SPEED_9600 );    /* UART0とprintf関連の初期化    */
    asm(" fset I ");                    /* 全体の割り込み許可           */

    printf( "Hello World!\n" );
//高速ﾌｰﾘｴ変換ﾌﾟﾛｸﾞﾗﾑのC言語ｿｰｽ

//    高速ﾌｰﾘｴ変換ﾌﾟﾛｸﾞﾗﾑのC言語ｿｰｽ
//     高速ﾌｰﾘｴ変換ﾌﾟﾛｸﾞﾗﾑのC言語ｿｰｽを以下に示します。
//     なお、ﾃﾞｰﾀ入力とﾃﾞｰﾀ出力の部分は省略しています。

//     IN_FM();//ﾃﾞｰﾀ入力
     PI=3.14159265358979;//円周率を設定
     n=(int)pow(2,L);//ﾃﾞｰﾀ数
     n1=n/2;//ﾃﾞｰﾀ数の1/2
     ns=n/2;//2進数の最上位の値
     sc=2.0*PI/(double)n;
     for(i=0;i < n;i++){m[i]=0;} //m[i]の初期化
     while(ns >= 1) //2進数の最上位の値が1になるまで繰り返し
     {
      for(L1=0;L1 < n;L1=L1+2*ns) //L1の値を0からnまで、2×最上位の値のstepで繰り返し
      {
       arg=m[L1]/2; //回転子=前の回転子の値/2
       arg2=arg+n1; //回転子2=回転子+ﾃﾞｰﾀ数の1/2
       c=cos(sc*(double)arg);
       s=sin(f*sc*(double)arg);
       for(i0=L1;i0 < L1+ns;i0++) //i0の値をL1の値からL1+2進数の最上位の値まで繰り返し
       {
        i1=i0+ns; //i1=i0+2進数の最上位の値
        X1=X[i1]*c-Y[i1]*s;
        Y1=Y[i1]*c+X[i1]*s;
        X[i1]=X[i0]-X1;
        Y[i1]=Y[i0]-Y1;
        X[i0]=X[i0]+X1;
        Y[i0]=Y[i0]+Y1;
        m[i0]=arg; //m[i0]に回転子を保存
        m[i1]=arg2; //m[i1]に回転子2を保存
       }
      }
      ns=ns/2;//2進数の最上位の値を繰り下げ
     }
     if(f < 0)//正規化処理
     {
      for(i=0;i < n; i++)
      {
       X[i]=X[i]/(double)n;
       Y[i]=Y[i]/(double)n;
      }
     }
     for(i=0;i < n; i++)//ﾋﾞｯﾄ反転処理
     {
      if(i < m[i])
      {
       j=m[i];
       t=X[i];X[i]=X[j];X[j]=t;
       t=Y[i];Y[i]=Y[j];Y[j]=t;
      }
     }
    //  OUT_FM();//ﾃﾞｰﾀ出力
    }

 
}

/************************************************************************/
/* R8C/35A ｽﾍﾟｼｬﾙﾌｧﾝｸｼｮﾝﾚｼﾞｽﾀ(SFR)の初期化                */
/************************************************************************/
void init( void )
{
    int i;

    /* ｸﾛｯｸをXINｸﾛｯｸ(20MHz)に変更 */
    prc0  = 1;                          /* ﾌﾟﾛﾃｸﾄ解除               */
    cm13  = 1;                          /* P4_6,P4_7をXIN-XOUT端子にする*/
    cm05  = 0;                          /* XINｸﾛｯｸ発振              */
    for(i=0; i<50; i++ );               /* 安定するまで少し待つ(約10ms) */
    ocd2  = 0;                          /* ｼｽﾃﾑｸﾛｯｸをXINにする  */
    prc0  = 0;                          /* ﾌﾟﾛﾃｸﾄON                 */

    /* ﾎﾟｰﾄの入出力設定 */
    prc2 = 1;                           /* PD0のﾌﾟﾛﾃｸﾄ解除          */
    pd0 = 0xe0;                         /* 7-5:LED 4:MicroSW 3-0:Sensor */
    p1  = 0x0f;                         /* 3-0:LEDは消灯                */
    pd1 = 0xdf;                         /* 5:RXD0 4:TXD0 3-0:LED        */
    pd2 = 0xfe;                         /* 0:PushSW                     */
    pd3 = 0xfb;                         /* 4:Buzzer 2:IR                */
    pd4 = 0x83;                         /* 7:XOUT 6:XIN 5-3:DIP SW 2:VREF*/
    pd5 = 0x40;                         /* 7:DIP SW                     */
    pd6 = 0xff;                         /* LEDなど出力                  */
}

/************************************************************************/
/* end of file                                                          */
/************************************************************************/
