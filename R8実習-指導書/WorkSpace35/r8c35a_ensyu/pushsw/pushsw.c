/****************************************************************************/
/* 対象マイコン R8C/35A                                                     */
/* ﾌｧｲﾙ内容     プッシュスイッチの読み込み                                  */
/* バージョン   Ver.1.20                                                    */
/* Date         2010.04.19                                                  */
/* Copyright    ルネサスマイコンカーラリー事務局                            */
/*              日立インターメディックス株式会社                            */
/****************************************************************************/
/*
入力：マイコンボードのプッシュスイッチSW3(P2_0)
出力：マイコンボードのLED(4bit)

マイコンボードのプッシュスイッチSW3(P2_0)から入力した状態を、
マイコンボードのLED(4bit)に出力します。
*/

/*======================================*/
/* インクルード                         */
/*======================================*/
#include "sfr_r835a.h"                  /* R8C/35A SFRの定義ファイル    */

/*======================================*/
/* シンボル定義                         */
/*======================================*/

/*======================================*/
/* プロトタイプ宣言                     */
/*======================================*/
void init( void );
unsigned char pushsw_get( void );
void led_out( unsigned char led );

/************************************************************************/
/* メインプログラム                                                     */
/************************************************************************/
void main( void )
{
    unsigned char d;

    init();                             /* 初期化                       */

    while( 1 ) {
//　問題(1) => スイッチが押されたときにオンボードを点灯させる
//        d = pushsw_get();
//        led_out( d );


//　問題(2) => スイッチが押されたときに1010,それ以外に0101を出力する
		d = 0x05;
		if(pushsw_get() != 0){
			d = 0x0a;
		}
		led_out( d );
    }
}

/************************************************************************/
/* R8C/35A スペシャルファンクションレジスタ(SFR)の初期化                */
/************************************************************************/
void init( void )
{
    int i;

    /* クロックをXINクロック(20MHz)に変更 */
    prc0  = 1;                          /* プロテクト解除               */
    cm13  = 1;                          /* P4_6,P4_7をXIN-XOUT端子にする*/
    cm05  = 0;                          /* XINクロック発振              */
    for(i=0; i<50; i++ );               /* 安定するまで少し待つ(約10ms) */
    ocd2  = 0;                          /* システムクロックをXINにする  */
    prc0  = 0;                          /* プロテクトON                 */

    /* ポートの入出力設定 */
    prc2 = 1;                           /* PD0のプロテクト解除          */
    pd0 = 0xe0;                         /* 7-5:LED 4:MicroSW 3-0:Sensor */
    p1  = 0x0f;                         /* 3-0:LEDは消灯                */
    pd1 = 0xdf;                         /* 5:RXD0 4:TXD0 3-0:LED        */
    pd2 = 0xfe;                         /* 0:PushSW                     */
    pd3 = 0xfb;                         /* 4:Buzzer 2:IR                */
    pd4 = 0x83;                         /* 7:XOUT 6:XIN 5-3:DIP SW 2:VREF*/
    pd5 = 0x40;                         /* 7:DIP SW                     */
    pd6 = 0xff;
}

/************************************************************************/
/* プッシュスイッチ値読み込み                                           */
/* 戻り値 プッシュスイッチの値 0:OFF 1:ON                               */
/************************************************************************/
unsigned char pushsw_get( void )
{
    unsigned char sw;

    sw  = ~p2;                          /* プッシュスイッチ読み込み     */
    sw &= 0x01;                         /* 不要ビットを"0"にする        */

    return  sw;
}

/************************************************************************/
/* マイコン部のLED出力                                                  */
/* 引数　 スイッチ値 0～15                                              */
/************************************************************************/
void led_out( unsigned char led )
{
    unsigned char data;

    led = ~led;
    led &= 0x0f;
    data = p1 & 0xf0;
    p1 = data | led;
}

/************************************************************************/
/* end of file                                                          */
/************************************************************************/
