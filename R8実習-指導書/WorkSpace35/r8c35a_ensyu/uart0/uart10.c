/****************************************************************************/
/* 対象マイコン R8C/35A                                                     */
/* ﾌｧｲﾙ内容     UART0の使用例                                               */
/* バージョン   Ver.1.20                                                    */
/* Date         2010.04.19                                                  */
/* Copyright    ルネサスマイコンカーラリー事務局                            */
/*              日立インターメディックス株式会社                            */
/****************************************************************************/
/*
入力：UART0(パソコンのキーボードで入力したデータ)
　　　※パソコンはTeraTermProなどの通信ソフトを使用します
出力：UART0(通信ソフトの画面)

RS232Cから出力されたデータをUART0で受信、そのままUART0から出力します。
TeraTermProなどの通信ソフトを通して、キーボードから入力した文字が
通信ソフトの画面にそのまま表示されます。
*/

/*======================================*/
/* インクルード                         */
/*======================================*/
#include    "sfr_r835a.h"               /* R8C/35A SFRの定義ファイル    */
#include    <stdio.h>

/*======================================*/
/* シンボル定義                         */
/*======================================*/

/*======================================*/
/* プロトタイプ宣言                     */
/*======================================*/
void init( void );
int get_uart0( unsigned char *s );
int put_uart0( unsigned char r );

/************************************************************************/
/* メインプログラム                                                     */
/************************************************************************/
void main( void )
{
    unsigned char   d;
    int             ret;

    init();                             /* SFRの初期化                  */

    while( 1 ) {
        ret = get_uart0( &d );
        p6 = d;
        if( ret == 1 ) put_uart0( d );
    }
}

/************************************************************************/
/* R8C/35A スペシャルファンクションレジスタ(SFR)の初期化                */
/************************************************************************/
void init( void )
{
    int i;

    /* クロックをXINクロック(20MHz)に変更 */
    prc0  = 1;                          /* プロテクト解除               */
    cm13  = 1;                          /* P4_6,P4_7をXIN-XOUT端子にする*/
    cm05  = 0;                          /* XINクロック発振              */
    for(i=0; i<50; i++ );               /* 安定するまで少し待つ(約10ms) */
    ocd2  = 0;                          /* システムクロックをXINにする  */
    prc0  = 0;                          /* プロテクトON                 */

    /* ポートの入出力設定 */
    prc2 = 1;                           /* PD0のプロテクト解除          */
    pd0 = 0x00;                         /* 7-5:LED 4:MicroSW 3-0:Sensor */
    p1  = 0x0f;                         /* 3-0:LEDは消灯                */
    pd1 = 0xdf;                         /* 5:RXD0 4:TXD0 3-0:LED        */
    pd2 = 0xfe;                         /* 0:PushSW                     */
    pd3 = 0xfb;                         /* 4:Buzzer 2:IR                */
    pd4 = 0x83;                         /* 7:XOUT 6:XIN 5-3:DIP SW 2:VREF*/
    pd5 = 0x40;                         /* 7:DIP SW                     */
    pd6 = 0xff;                         /* LEDなど出力                  */

    /* UART0の設定 */
    /* U0BRG = ｶｳﾝﾄｿｰｽの周波数/(設定したいbps*16)-1
             = 20MHz          /(     9600    *16)-1
             = 129.208 = 129
    */
    u0sr = 0x05;                        /* P14=TXD0,P15=RXD0に設定      */
    u0c0 = 0x00;                        /* カウントソースなどの設定     */
    u0c1 = 0x05;                        /* 送信､受信許可                */
    u0brg = 129;                        /* 通信速度=9600pbs             */
    u0mr = 0x05;                        /* UART0 ﾃﾞｰﾀ長8bit 1ｽﾄｯﾌﾟﾋﾞｯﾄ  */
}

/************************************************************************/
/* １文字受信                                                           */
/* 引数　 受信文字格納アドレス                                          */
/* 戻り値 -1:受信エラー 0:受信なし 1:受信あり 文字は*sに格納            */
/************************************************************************/
int get_uart0( unsigned char *s )
{
    int ret = 0, i;
    unsigned int data;

    if (ri_u0c1 == 1){                  /* 受信データあり？             */
        data = u0rb;
        *s = (unsigned char)data;
        ret = 1;
        if( data & 0xf000 ) {           /* エラーあり？                 */
            /* エラー時は再設定 */
            re_u0c1 = 0;
            for( i=0; i<50; i++ );
            re_u0c1 = 1;

            ret = -1;
        }
    }
    return ret;
}

/************************************************************************/
/* １文字出力                                                           */
/* 引数　 送信データ                                                    */
/* 戻り値 0:送信中のため、送信できず 1:送信セット完了                   */
/************************************************************************/
int put_uart0( unsigned char r )
{
    if(ti_u0c1 == 1) {                  /* 送信データなし？             */
        u0tbl = r;
        return 1;
    } else {
        /* 先に送信中(今回のデータは送信せずに終了) */
        return 0;
    }
}

/************************************************************************/
/* end of file                                                          */
/************************************************************************/
