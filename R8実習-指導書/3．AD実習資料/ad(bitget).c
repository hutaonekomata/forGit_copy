/****************************************************************************/
/* 対象マイコン R8C/35A                                                     */
/* ﾌｧｲﾙ内容     A/D変換(単発モード)                                         */
/* バージョン   Ver.1.20                                                    */
/* Date         2010.04.19                                                  */
/* Copyright    ルネサスマイコンカーラリー事務局                            */
/*              日立インターメディックス株式会社                            */
/****************************************************************************/
/*
入力：AN7(P0_0)端子 0～5V(ミニマイコンカーの赤外線フォトインタラプタU8)
出力：P1_3-P1_0(マイコンボードのLED)

AN7(P0_0)端子から入力した電圧をA/D変換して、デジタル値をマイコンボードの
LEDへ出力します。
*/

/*======================================*/
/* インクルード                         */
/*======================================*/
#include "sfr_r835a.h"                  /* R8C/35A SFRの定義ファイル    */

/*======================================*/
/* シンボル定義                         */
/*======================================*/

/*======================================*/
/* プロトタイプ宣言                     */
/*======================================*/
void init( void );
int get_ad7( void );
int get_adn( char sw );
unsigned char dipsw_get( void );
unsigned char bit_get( void );
void led_out( unsigned char led );

/************************************************************************/
/* メインプログラム                                                     */
/************************************************************************/
void main( void )
{
    int ad;

    init();                             /* 初期化                       */

    while( 1 ) {
        ad = get_adn(bit_get() );
        ad = ad >> 6;
        led_out( ad );
    }
}

/************************************************************************/
/* R8C/35A スペシャルファンクションレジスタ(SFR)の初期化                */
/************************************************************************/
void init( void )
{
    int i;

    /* クロックをXINクロック(20MHz)に変更 */
    prc0  = 1;                          /* プロテクト解除               */
    cm13  = 1;                          /* P4_6,P4_7をXIN-XOUT端子にする*/
    cm05  = 0;                          /* XINクロック発振              */
    for(i=0; i<50; i++ );               /* 安定するまで少し待つ(約10ms) */
    ocd2  = 0;                          /* システムクロックをXINにする  */
    prc0  = 0;                          /* プロテクトON                 */

    /* ポートの入出力設定 */
    prc2 = 1;                           /* PD0のプロテクト解除          */
    pd0 = 0xe0;                         /* 7-5:LED 4:SW 3-0:アナログ電圧*/
    p1  = 0x0f;                         /* 3-0:LEDは消灯                */
    pd1 = 0xdf;                         /* 5:RXD0 4:TXD0 3-0:LED        */
    pd2 = 0xfe;                         /* 0:PushSW                     */
    pd3 = 0xfb;                         /* 4:Buzzer 2:IR                */
    pd4 = 0x83;                         /* 7:XOUT 6:XIN 5-3:DIP SW 2:VREF*/
    pd5 = 0x40;                         /* 7:DIP SW                     */
    pd6 = 0xff;
}

/************************************************************************/
/* A/D値読み込み(AN7)                                                   */
/* 引数　 なし                                                          */
/* 戻り値 A/D値 0～1023                                                 */
/************************************************************************/
int get_ad7( void )
{
    int i;

    /* A/Dコンバータの設定 */
    admod   = 0x03;                     /* 単発モードに設定             */
    adinsel = 0x07;                     /* 入力端子AN7(P0_0)を選択      */
    adcon1  = 0x30;                     /* A/D動作可能                  */
    asm(" nop ");                       /* φADの1サイクルウエイト入れる*/
    adcon0  = 0x01;                     /* A/D変換スタート              */

    while( adcon0 & 0x01 );             /* A/D変換終了待ち              */

    i = ad7;

    return i;
}
/************************************************************************/
/* A/D値読み込み(AN7)                                                   */
/* 引数　 なし                                                          */
/* 戻り値 A/D値 0～1023                                                 */
/************************************************************************/
int get_adn( char sw )
{
    int i;

    /* A/Dコンバータの設定 */
    admod   = 0x03;                     /* 単発モードに設定             */
    if(sw<4) sw=4;
    if(sw>7) sw=7;
    adinsel = sw;                     /* 入力端子を選択      */
    adcon1  = 0x30;                     /* A/D動作可能                  */
    asm(" nop ");                       /* φADの1サイクルウエイト入れる*/
    adcon0  = 0x01;                     /* A/D変換スタート              */

    while( adcon0 & 0x01 );             /* A/D変換終了待ち              */
	switch (sw){
		case 4:
				i = ad4;
			break;
		case 5:
				i = ad5;
			break;
		case 6:
				i = ad6;
			break;
		case 7:
				i = ad7;
			break;
		default:
					/* どれでもない場合は待機状態に戻す */
				i=0;
			break;
	}
    return i;
}


/************************************************************************/
/* マイコン部のLED出力                                                  */
/* 引数　 スイッチ値 0～15                                              */
/************************************************************************/
void led_out( unsigned char led )
{
    unsigned char data;

    led = ~led;
    led &= 0x0f;
    data = p1 & 0xf0;
    p1 = data | led;
}
/************************************************************************/
/* ディップスイッチ値読み込み                                           */
/* 戻り値 スイッチ値 0～15                                              */
/************************************************************************/
unsigned char dipsw_get( void )
{
    unsigned char sw, sw1, sw2;

    sw1 = (p5>>4) & 0x08;               /* ディップスイッチ読み込み3    */
    sw2 = (p4>>3) & 0x07;               /* ディップスイッチ読み込み2,1,0*/
    sw = sw1 | sw2;                     /* P5とP4の値を合わせる         */

    return  sw;
}
unsigned char bit_get( void )
{  
	unsigned char w,ret;
	w=dipsw_get();
	if(w==1) ret=7;
	if(w==2) ret=6;
	if(w==4) ret=5;
	if(w==8) ret=4;
    return  ret;
}

/************************************************************************/
/* end of file                                                          */
/************************************************************************/
