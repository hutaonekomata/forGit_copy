/****************************************************************************/
/* 対象マイコン R8C/35A                                                     */
/* ﾌｧｲﾙ内容     データの入力、出力                                          */
/* バージョン   Ver.1.20                                                    */
/* Date         2010.04.19                                                  */
/* Copyright    ルネサスマイコンカーラリー事務局                            */
/*              日立インターメディックス株式会社                            */
/****************************************************************************/
/*
入力：マイコンボードのディップスイッチ(4bit)
出力：マイコンボードのLED(4bit)

マイコンボードのディップスイッチ(4bit)から入力した状態を、
マイコンボードのLED(4bit)に出力します。
*/

/*======================================*/
/* インクルード                         */
/*======================================*/
#include "sfr_r835a.h"                  /* R8C/35A SFRの定義ファイル    */

/*======================================*/
/* シンボル定義                         */
/*======================================*/
#define	SCK 		p2_0
#define	RCK 		p2_1
#define	SCLK 		p2_2
#define	SI    		p2_3
#define	DAT 		p3

#define	COL0		p3_0
#define	COL1		p3_1
#define	COL2		p3_2
#define	COL3		p3_3
#define	COL4		p3_4
#define	COL5		p3_5
#define	COL6		p3_6
#define	COL7		p3_7

#define	SW1 		p0_1
#define	SW2 		p0_2
#define	A_IN		ad0
/*======================================*/
/* グローバル変数宣言                     */
/*======================================*/
disp.Byte[8];
union {
    unsigned int  word;            //  LED_disp.word:１６bit  シフター用
    struct
    {
        unsigned char  LSB:1;      // シフトレジスタ の下位ビット入力データ用
        unsigned char  dotlow:7;
        unsigned char  dothigh:7;
        unsigned char  MSB:1;      // シフトレジスタ の上位ビット入力データ用
    }BIT;
}LED_display;

/*======================================*/
/* プロトタイプ宣言                     */
/*======================================*/
void init( void );
unsigned char dipsw_get( void );
void led_out( unsigned char led );
void send_shifter(int x){
/************************************************************************/
/* メインプログラム                                                     */
/************************************************************************/
void main( void )
{
    unsigned char d;

    init();                             /* 初期化                       */
	send_shifter(0x55aa);
    while( 1 ) {

        d = dipsw_get();
        led_out( d );
    }
}

/************************************************************************/
/* R8C/35A スペシャルファンクションレジスタ(SFR)の初期化                */
/************************************************************************/
void init( void )
{
    int i;

    /* クロックをXINクロック(20MHz)に変更 */
    prc0  = 1;                          /* プロテクト解除               */
    cm13  = 1;                          /* P4_6,P4_7をXIN-XOUT端子にする*/
    cm05  = 0;                          /* XINクロック発振              */
    for(i=0; i<50; i++ );               /* 安定するまで少し待つ(約10ms) */
    ocd2  = 0;                          /* システムクロックをXINにする  */
    prc0  = 0;                          /* プロテクトON                 */

    /* ポートの入出力設定 */
    prc2 = 1;                           /* PD0のプロテクト解除          */
    pd0 = 0xe0;                         /* 7-5:LED 4:MicroSW 3-0:Sensor */
    p1  = 0x0f;                         /* 3-0:LEDは消灯                */
    pd1 = 0xdf;                         /* 5:RXD0 4:TXD0 3-0:LED        */
    pd2 = 0xff;                         /* 0:PushSW                     */
    pd3 = 0xff;                         /* 4:Buzzer 2:IR                */
    pd4 = 0x83;                         /* 7:XOUT 6:XIN 5-3:DIP SW 2:VREF*/
    pd5 = 0x40;                         /* 7:DIP SW                     */
    pd6 = 0xff;
}

/************************************************************************/
/* ディップスイッチ値読み込み                                           */
/* 戻り値 スイッチ値 0～15                                              */
/************************************************************************/
unsigned char dipsw_get( void )
{
    unsigned char sw, sw1, sw2;

    sw1 = (p5>>4) & 0x08;               /* ディップスイッチ読み込み3    */
    sw2 = (p4>>3) & 0x07;               /* ディップスイッチ読み込み2,1,0*/
    sw = sw1 | sw2;                     /* P5とP4の値を合わせる         */

    return  sw;
}

/************************************************************************/
/* マイコン部のLED出力                                                  */
/* 引数　 スイッチ値 0～15                                              */
/************************************************************************/
void led_out( unsigned char led )
{
    unsigned char data;

    led = ~led;
    led &= 0x0f;
    data = p1 & 0xf0;
    p1 = data | led;
}

/************************************************************************/
/* シフトレジスタのLED出力                                                  */
/* 引数                                              */
/************************************************************************/




void send_shifter(int x){
    /****** シフトレジスタ  データセット    ************/
    //   表示確認用  引数を表示バッファに送る
    //      割り込み以前のシステムチェック用
    //   とりあえず  5列目で光らせるようにしたが
    //   カラムチェックの場合は    COL_X  0～７  で確認
    int i;
    LED_display.word=x;
    for(i=0;i<16;i++){
        SI=LED_display.BIT.LSB;
        SCK=0;
        SCK=1;
        LED_display.word = LED_display.word >>1;
    }
    RCK=0;
    RCK=1;
    COL_5=1;
}

/************************************************************************/
/* end of file                                                          */
/************************************************************************/
